## west.yml
```yaml
manifest:
  version: "0.13"

  remotes:
    - name: zephyrproject
      url-base: https://github.com/zephyrproject-rtos
    - name: yash
      url-base: https://github.com/YashGiramkar

  projects:
    - name: zephyr
      remote: zephyrproject
      repo-path: zephyr
      revision: v3.7-branch
      path: zephyr
      import: true

    # ---- Application as a west project ----
    - name: app-blinky
      remote: yash
      repo-path: app-blinky
      revision: main

  self:
    path: .
```
